/**
 * @file    dev_oled.c
 * @brief   Driver para display OLED 128×64 SSD1315 vía I²C1.
 *
 * @details
 *  Protocolo I²C del SSD1315:
 *    [ADDR] [CTRL_CMD  0x00] [cmd]       → enviar comando
 *    [ADDR] [CTRL_DATA 0x40] [d0..dN]   → enviar datos de píxeles
 *
 *  Modo horizontal: al completar una columna salta a la siguiente,
 *  al completar una página salta a la siguiente → ideal para volcar
 *  el buffer completo en una sola transacción I²C.
 *
 * @author  Matías Durante
 * @version 1.0
 * @date    2025
 */

#include "dev_oled.h"
#include "oled_registers.h"
#include "cmsis_os2.h"
#include <string.h>
#include <stdio.h>

/* =========================================================================== */
/*                          FUENTE 6×8 (ASCII 32–127)                         */
/* =========================================================================== */
/* Cada carácter: 6 bytes. Byte = columna, bit0 = fila superior.              */
static const uint8_t s_font[][OLED_FONT_W] = {
    { 0x00, 0x00, 0x00, 0x00, 0x00, 0x00 }, // 32 ' '
    { 0x00, 0x00, 0x5F, 0x00, 0x00, 0x00 }, // 33 '!'
    { 0x00, 0x07, 0x00, 0x07, 0x00, 0x00 }, // 34 '"'
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    { 0x08, 0x1C, 0x2A, 0x08, 0x08, 0x00 }, // 127
};

/* =========================================================================== */
/*                          BUFFER INTERNO                                     */
/* =========================================================================== */
/* buf[0] = OLED_CTRL_DATA, buf[1..1024] = píxeles (8 páginas × 128 cols)    */
static uint8_t s_buf[1 + OLED_BUF_SIZE];

/* =========================================================================== */
/*                          FUNCIONES PRIVADAS                                 */
/* =========================================================================== */

static void buf_clear(void)
{
    memset(s_buf + 1, 0x00, OLED_BUF_SIZE);
    s_buf[0] = OLED_CTRL_DATA;
}

static void buf_flush(void)
{
    /* Configurar ventana: col 0-127, page 0-7 */
    OLED_port_send_cmd(OLED_CMD_SET_COL_ADDR);
    OLED_port_send_cmd(0x00);
    OLED_port_send_cmd(0x7F);
    OLED_port_send_cmd(OLED_CMD_SET_PAGE_ADDR);
    OLED_port_send_cmd(0x00);
    OLED_port_send_cmd(0x07);

    OLED_port_flush(s_buf, sizeof(s_buf));
}

static void buf_put_char(uint8_t col, uint8_t page, char c)
{
    if (c < 32 || c > 127) c = ' ';
    uint16_t offset = 1U + (uint16_t)page * OLED_WIDTH + col;
    const uint8_t *g = s_font[(uint8_t)c - 32];
    for (uint8_t i = 0; i < OLED_FONT_W && (col + i) < OLED_WIDTH; i++)
        s_buf[offset + i] = g[i];
}

static void buf_draw_hline(uint8_t page)
{
    uint16_t offset = 1U + (uint16_t)page * OLED_WIDTH;
    for (uint8_t i = 0; i < OLED_WIDTH; i++)
        s_buf[offset + i] = 0xFF;
}

static const char *weekday_str(uint8_t wd)
{
    switch (wd) {
        case 1: return "Lun"; case 2: return "Mar"; case 3: return "Mie";
        case 4: return "Jue"; case 5: return "Vie"; case 6: return "Sab";
        case 7: return "Dom"; default: return "---";
    }
}

/* =========================================================================== */
/*                          PANTALLAS PREDEFINIDAS                             */
/* =========================================================================== */

static void screen_weights(const OLED_Data *d)
{
    char line[22];

    OLED_PutString(14, 0, "Guardian Pet");
    buf_draw_hline(1);

    OLED_PutString(0, 2, "Tanque:");
    int tk_int = (int)d->tankKg;
    int tk_dec = (int)((d->tankKg - (float)tk_int) * 1000.0f);
    if (tk_dec < 0) tk_dec = -tk_dec;
    snprintf(line, sizeof(line), "  %d.%03d kg", tk_int, tk_dec);
    OLED_PutString(0, 3, line);

    OLED_PutString(0, 5, "Plato:");
    snprintf(line, sizeof(line), "  %d g", (int)d->plateGrams);
    OLED_PutString(0, 6, line);
}

static void screen_clock(const OLED_Data *d)
{
    char line[22];

    OLED_PutString(14, 0, "Guardian Pet");
    buf_draw_hline(1);

    snprintf(line, sizeof(line), "  %02d:%02d:%02d",
             d->hour, d->minute, d->second);
    OLED_PutString(0, 3, line);

    snprintf(line, sizeof(line), " %s %02d/%02d/%02d",
             weekday_str(d->weekday), d->day, d->month, d->year);
    OLED_PutString(0, 5, line);
}

/* =========================================================================== */
/*                          API PÚBLICA                                        */
/* =========================================================================== */

OLED_Status OLED_Init(void)
{
    osDelay(OLED_DELAY_INIT_MS);

    OLED_port_send_cmd(OLED_CMD_DISPLAY_OFF);
    OLED_port_send_cmd2(OLED_CMD_SET_CLK_DIV,      OLED_CLK_DIV_DEFAULT);
    OLED_port_send_cmd2(OLED_CMD_SET_MUX_RATIO,    OLED_MUX_64);
    OLED_port_send_cmd2(OLED_CMD_SET_DISPLAY_OFFSET, 0x00);
    OLED_port_send_cmd(OLED_CMD_SET_START_LINE | 0x00);
    OLED_port_send_cmd2(OLED_CMD_CHARGE_PUMP,       OLED_CHARGE_PUMP_ON);
    OLED_port_send_cmd2(OLED_CMD_SET_MEM_MODE,      OLED_MEM_MODE_HORIZONTAL);
    OLED_port_send_cmd(OLED_CMD_SEG_REMAP_FLIP);
    OLED_port_send_cmd(OLED_CMD_COM_SCAN_FLIP);
    OLED_port_send_cmd2(OLED_CMD_SET_COM_PINS,      OLED_COM_PINS_ALT);
    OLED_port_send_cmd2(OLED_CMD_SET_CONTRAST,      OLED_CONTRAST_DEFAULT);
    OLED_port_send_cmd2(OLED_CMD_SET_PRECHARGE,     OLED_PRECHARGE_DEFAULT);
    OLED_port_send_cmd2(OLED_CMD_SET_VCOMH,         OLED_VCOMH_DEFAULT);
    OLED_port_send_cmd(OLED_CMD_RESUME_RAM);
    OLED_port_send_cmd(OLED_CMD_DISPLAY_NORMAL);
    OLED_port_send_cmd(OLED_CMD_DEACTIVATE_SCROLL);
    OLED_port_send_cmd(OLED_CMD_DISPLAY_ON);

    OLED_Clear();
    return OLED_OK;
}

void OLED_Clear(void)
{
    buf_clear();
    buf_flush();
}

void OLED_PutString(uint8_t col, uint8_t page, const char *str)
{
    while (*str && col < OLED_WIDTH) {
        buf_put_char(col, page, *str++);
        col += OLED_FONT_W;
    }
}

void OLED_Update(const OLED_Data *data)
{
    static uint32_t s_last_switch = 0;
    static bool     s_show_clock  = false;

    uint32_t now = osKernelGetTickCount();
    if ((now - s_last_switch) >= OLED_SCREEN_SWITCH_MS) {
        s_show_clock  = !s_show_clock;
        s_last_switch = now;
    }

    buf_clear();

    if (s_show_clock)
        screen_clock(data);
    else
        screen_weights(data);

    buf_flush();
}

void OLED_ShowDispensing(void)
{
    buf_clear();
    OLED_PutString(14, 0, "Guardian Pet");
    buf_draw_hline(1);
    OLED_PutString(8,  3, "** DANDO  **");
    OLED_PutString(8,  4, "** RACION **");
    buf_flush();
}

void OLED_ShowError(void)
{
    buf_clear();
    OLED_PutString(20, 2, "   ERROR   ");
    OLED_PutString(4,  4, "Reiniciando...");
    buf_flush();
}
